/*
 * sh1106.c
 *
 *  Created on: Mar 2, 2026
 *      Author: Krishay Bhople
 */

#include "sh1106.h"
#include <string.h>

/* 5x7 ASCII font, characters 32 (space) through 126 (~) */
static const uint8_t Font5x7[][5] = {
    {0x00,0x00,0x00,0x00,0x00}, // 32 (space)
    {0x00,0x00,0x5F,0x00,0x00}, // 33 !
    {0x00,0x07,0x00,0x07,0x00}, // 34 "
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    {0x08,0x08,0x2A,0x1C,0x08}, // 126 ~
};

static uint8_t SH1106_Buffer[SH1106_WIDTH * SH1106_HEIGHT / 8];

static void SH1106_WriteCommand(I2C_HandleTypeDef *hi2c, uint8_t cmd) {
    HAL_I2C_Mem_Write(hi2c, SH1106_I2C_ADDR, 0x00, 1, &cmd, 1, 10);
}

void SH1106_Init(I2C_HandleTypeDef *hi2c) {
    HAL_Delay(100);
    SH1106_WriteCommand(hi2c, 0xAE); // Display Off
    SH1106_WriteCommand(hi2c, 0xA8); // Set MUX Ratio
    SH1106_WriteCommand(hi2c, 0x3F);
    SH1106_WriteCommand(hi2c, 0xD3); // Set Display Offset
    SH1106_WriteCommand(hi2c, 0x00);
    SH1106_WriteCommand(hi2c, 0x40); // Set Display Start Line
    SH1106_WriteCommand(hi2c, 0xA1); // Set Segment Re-map
    SH1106_WriteCommand(hi2c, 0xC8); // Set COM Output Scan Direction
    SH1106_WriteCommand(hi2c, 0xDA); // Set COM Pins Hardware Config
    SH1106_WriteCommand(hi2c, 0x12);
    SH1106_WriteCommand(hi2c, 0x81); // Set Contrast
    SH1106_WriteCommand(hi2c, 0x7F);
    SH1106_WriteCommand(hi2c, 0xA4); // Disable Entire Display On
    SH1106_WriteCommand(hi2c, 0xA6); // Set Normal Display
    SH1106_WriteCommand(hi2c, 0xD5); // Set Osc Frequency
    SH1106_WriteCommand(hi2c, 0x80);
    SH1106_WriteCommand(hi2c, 0x8D); // Enable Charge Pump
    SH1106_WriteCommand(hi2c, 0x14);
    SH1106_WriteCommand(hi2c, 0xAF); // Display On
    SH1106_Fill(0);
    SH1106_UpdateScreen(hi2c);
}

void SH1106_Fill(uint8_t color) {
    memset(SH1106_Buffer, (color ? 0xFF : 0x00), sizeof(SH1106_Buffer));
}

void SH1106_DrawPixel(uint8_t x, uint8_t y, uint8_t color) {
    if (x >= SH1106_WIDTH || y >= SH1106_HEIGHT) return;
    if (color)
        SH1106_Buffer[x + (y / 8) * SH1106_WIDTH] |= (1 << (y % 8));
    else
        SH1106_Buffer[x + (y / 8) * SH1106_WIDTH] &= ~(1 << (y % 8));
}

void SH1106_WriteChar(uint8_t x, uint8_t y, char ch, uint8_t size) {
    if (ch < 32 || ch > 126) ch = '?';
    const uint8_t *glyph = Font5x7[ch - 32];

    for (uint8_t col = 0; col < 5; col++) {
        uint8_t line = glyph[col];
        for (uint8_t row = 0; row < 7; row++) {
            uint8_t pixel = (line >> row) & 0x01;
            if (size == 1) {
                SH1106_DrawPixel(x + col, y + row, pixel);
            } else {
                /* Scale up: each source pixel becomes a size x size block */
                for (uint8_t sy = 0; sy < size; sy++) {
                    for (uint8_t sx = 0; sx < size; sx++) {
                        SH1106_DrawPixel(
                            x + col * size + sx,
                            y + row * size + sy,
                            pixel
                        );
                    }
                }
            }
        }
    }
}

void SH1106_WriteString(uint8_t x, uint8_t y, const char *str, uint8_t size) {
    uint8_t x_pos = x;
    /* Each character is 5 pixels wide + 1 pixel gap, scaled by size */
    uint8_t char_width = 6 * size;

    while (*str) {
        if (x_pos + char_width > SH1106_WIDTH) {
            /* Wrap to next line */
            x_pos = x;
            y += 8 * size;
            if (y + 7 * size > SH1106_HEIGHT) break;
        }
        SH1106_WriteChar(x_pos, y, *str, size);
        x_pos += char_width;
        str++;
    }
}

void SH1106_UpdateScreen(I2C_HandleTypeDef *hi2c) {
    for (uint8_t i = 0; i < 8; i++) {
        SH1106_WriteCommand(hi2c, 0xB0 + i);
        SH1106_WriteCommand(hi2c, 0x00 + (SH1106_COLUMN_OFFSET & 0x0F));
        SH1106_WriteCommand(hi2c, 0x10 + ((SH1106_COLUMN_OFFSET >> 4) & 0x0F));
        HAL_I2C_Mem_Write(hi2c, SH1106_I2C_ADDR, 0x40, 1,
                          &SH1106_Buffer[SH1106_WIDTH * i], SH1106_WIDTH, 100);
    }
}